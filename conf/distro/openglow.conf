## conf/distro/openglow.conf
```bitbake
require conf/distro/include/fslc-base.inc

DISTRO = "openglow"
DISTRO_NAME = "OpenGlow"
DISTRO_VERSION = "0.0.1-alpha"

DISTRO_FEATURES_remove = " 3g alsa avahi irda nfc nfs pcmcia pulseaudio wayland x11 zeroconf "
```

## conf/layer.conf
```bitbake
LAYERSERIES_COMPAT_openglow = "sumo"

BBPATH .= ":${LAYERDIR}"
BBFILES += "${LAYERDIR}/recipes-*/*/*.bb ${LAYERDIR}/recipes-*/*/*.bbappend"

BBFILE_COLLECTIONS += "openglow"
BBFILE_PATTERN_openglow := "^${LAYERDIR}/"
BBFILE_PRIORITY_openglow = "8"

LICENSE_PATH += "${LAYERDIR}"
```

## conf/machine/include/openglow_std.inc
```bitbake
PREFERRED_PROVIDER_virtual/kernel ??= "linux-openglow"

PREFERRED_PROVIDER_u-boot ??= "u-boot"
PREFERRED_PROVIDER_virtual/bootloader ??= "u-boot"
PREFERRED_PROVIDER_u-boot-fw-utils ??= "u-boot-fw-utils"
```

## conf/machine/openglow_std.conf
```bitbake
#@TYPE: Machine
#@NAME: OpenGlow Standard w/ Nitrogen6X-SOM2 MX6D 1G
#@SOC: i.MX6 Q/DL
#@DESCRIPTION: Machine configuration for OpenGlow Standard Board
#@MAINTAINER: Scott Wiederhold <s.e.wiederhold@gmail.com>
#
# This machine will build for the standard Dual/Quad-Core, 1GB
# SOM2 module from Boundary Devices.
#
# In the future, it will build for other combinations.
# These can be set in the UBOOT_MACHINE variable in your
# local.conf according to the following table:
#
# Processor           Memory    Configuration
# --------------      ------    --------------------
# i.MX6Quad/Dual        1GB     openglow_std_n6x2q_1g_defconfig
#

MACHINEOVERRIDES =. "mx6:mx6q:mx6dl:"

require conf/machine/include/imx-base.inc
require conf/machine/include/openglow_std.inc
require conf/machine/include/tune-cortexa9.inc

KERNEL_DEVICETREE = "openglow_std.dtb"

UBOOT_MACHINE ?= "openglow_std_n6x2q_1g_defconfig"
UBOOT_MAKE_TARGET = "all"
UBOOT_SUFFIX = "imx"
BOOT_SCRIPTS = "u-boot_upgrade-${MACHINE}.scr:u-boot_upgrade.scr"
WKS_FILE = "imx-uboot-bootpart.wks"

SERIAL_CONSOLE = "115200 ttymxc0"

MACHINE_FIRMWARE_append_mx6 = " linux-firmware-wl12xx"

MACHINE_FEATURES += " wifi bluetooth"

MACHINE_ESSENTIAL_EXTRA_RDEPENDS += " \
    kernel-module-openglow \
    kernel-module-lis2hh12 \
"
```

## meta-glowforge-bsp/conf/distro/glowforge.conf
```bitbake
require conf/distro/include/fslc-base.inc

DISTRO = "glowforge"
DISTRO_NAME = "OpenGlow Glowforge"
DISTRO_VERSION = "0.2.0"

DISTRO_FEATURES_remove = " \
  3g alsa avahi bluetooth bluez5 ext2 ipv6 irda nfc nfs opengl pci pcmcia \
  pulseaudio vulkan wayland x11 zeroconf "
```

## meta-glowforge-bsp/conf/layer.conf
```bitbake
# We have a conf and classes directory, add to BBPATH
BBPATH .= ":${LAYERDIR}"

# We have recipes-* directories, add to BBFILES
BBFILES += "${LAYERDIR}/recipes-*/*/*.bb \
	${LAYERDIR}/recipes-*/*/*.bbappend"

BBFILE_COLLECTIONS += "glowforge-bsp-layer"
BBFILE_PATTERN_glowforge-bsp-layer = "^${LAYERDIR}/"
BBFILE_PRIORITY_glowforge-bsp-layer = "9"

# This should only be incremented on significant changes that will
# cause compatibility issues with other layers
LAYERVERSION_glowforge-bsp-layer = "1"

LAYERSERIES_COMPAT_glowforge-bsp-layer = "dunfell gatesgarth"
```

## meta-glowforge-bsp/conf/machine/glowforge.conf
```bitbake
#@TYPE: Machine
#@NAME: Glowforge Basic/Plus/Pro Compatible
#@SOC: i.MX6S
#@DESCRIPTION: Machine configuration for Glowforge Basic/Plus/Pro
#@MAINTAINER: Scott Wiederhold <s.e.wiederhold@gmail.com>
#
# This machine will build for the standard Glowforge CNC laser
# with the imx6 Solo processor.
#

MACHINEOVERRIDES =. "mx6:mx6dl:"

require conf/machine/include/imx-base.inc
require conf/machine/include/glowforge.inc
require conf/machine/include/tune-cortexa9.inc

PREFERRED_PROVIDER_virtual/kernel ??= "linux-glowforge"

KERNEL_DEVICETREE = "glowforge.dtb"

UBOOT_MACHINE ?= "glowforge_defconfig"
UBOOT_MAKE_TARGET = "all"
UBOOT_SUFFIX = "imx"
WKS_FILE = "glowforge.wks"

SERIAL_CONSOLE = "115200 ttymxc0"

MACHINE_FIRMWARE += " linux-firmware-wl18xx"

MACHINE_FEATURES += " wifi"

MACHINE_ESSENTIAL_EXTRA_RDEPENDS += " \
  kernel-module-glowforge \
"
```

## meta-glowforge-bsp/conf/machine/include/glowforge.inc
```bitbake
PREFERRED_PROVIDER_u-boot ??= "u-boot"
PREFERRED_PROVIDER_virtual/bootloader ??= "u-boot"
PREFERRED_PROVIDER_u-boot-fw-utils ??= "u-boot-fw-utils"

PREFERRED_PROVIDER_virtual/xserver = ""
```

## meta-glowforge-bsp/recipes-kernel/linux/linux-glowforge-4.14.98/defconfig
```kconfig
CONFIG_ARM=y
CONFIG_GENERIC_BUG=y
#
# General setup
#
CONFIG_KERNEL_LZO=y
CONFIG_SWAP=y
CONFIG_SYSVIPC=y
CONFIG_SYSVIPC_SYSCTL=y
CONFIG_CROSS_MEMORY_ATTACH=y
CONFIG_FHANDLE=y

#
# Timers subsystem
#
CONFIG_NO_HZ=y
CONFIG_HIGH_RES_TIMERS=y

#
# RCU Subsystem
#
CONFIG_BUILD_BIN2C=y
CONFIG_IKCONFIG=y
CONFIG_IKCONFIG_PROC=y
CONFIG_EXPERT=y
CONFIG_UID16=y
CONFIG_MULTIUSER=y
CONFIG_SYSFS_SYSCALL=y
CONFIG_POSIX_TIMERS=y
CONFIG_KALLSYMS=y
CONFIG_KALLSYMS_ALL=y
CONFIG_PRINTK=y
CONFIG_PRINTK_NMI=y
CONFIG_BUG=y
CONFIG_ELF_CORE=y
CONFIG_BASE_FULL=y
CONFIG_FUTEX=y
CONFIG_FUTEX_PI=y
CONFIG_EPOLL=y
CONFIG_SIGNALFD=y
CONFIG_TIMERFD=y
CONFIG_EVENTFD=y
CONFIG_SHMEM=y
CONFIG_AIO=y
CONFIG_ADVISE_SYSCALLS=y
CONFIG_MEMBARRIER=y
# CONFIG_EMBEDDED is not set

#
# Kernel Performance Events And Counters
#
CONFIG_PERF_EVENTS=y
CONFIG_VM_EVENT_COUNTERS=y
CONFIG_SLUB_DEBUG=y
CONFIG_COMPAT_BRK=y
CONFIG_SLUB=y
CONFIG_SLAB_MERGE_DEFAULT=y
CONFIG_SLUB_CPU_PARTIAL=y
CONFIG_HAVE_HW_BREAKPOINT=y
CONFIG_STRICT_KERNEL_RWX=y
CONFIG_STRICT_MODULE_RWX=y

#
# GCOV-based kernel profiling
#
CONFIG_MODULES=y
CONFIG_MODULE_UNLOAD=y
CONFIG_MODVERSIONS=y
CONFIG_MODULE_SRCVERSION_ALL=y
CONFIG_BLOCK=y
CONFIG_LBDAF=y

#
# Partition Types
#
CONFIG_MSDOS_PARTITION=y

#
# IO Schedulers
#
CONFIG_IOSCHED_DEADLINE=y
CONFIG_IOSCHED_CFQ=y
CONFIG_DEFAULT_CFQ=y
CONFIG_MQ_IOSCHED_DEADLINE=y
CONFIG_MQ_IOSCHED_KYBER=y

#
# System Type
#
CONFIG_MMU=y
CONFIG_ARCH_MULTIPLATFORM=y

#
# CPU Core family selection
#
CONFIG_ARCH_MULTI_V7=y
CONFIG_ARCH_MXC=y
CONFIG_MXC_EPIT_API=y

#
# Cortex-A platforms
#
CONFIG_SOC_IMX6=y
CONFIG_SOC_IMX6Q=y

#
# Processor Features
#
CONFIG_ARM_THUMB=y
CONFIG_SWP_EMULATE=y
CONFIG_HARDEN_BRANCH_PREDICTOR=y
CONFIG_KUSER_HELPERS=y
CONFIG_OUTER_CACHE=y
CONFIG_OUTER_CACHE_SYNC=y
CONFIG_CACHE_L2X0=y
CONFIG_PL310_ERRATA_769419=y
CONFIG_ARM_HEAVY_MB=y
CONFIG_DEBUG_ALIGN_RODATA=y
CONFIG_ARM_ERRATA_643719=y

#
# Kernel Features
#
CONFIG_SMP=y
CONFIG_SMP_ON_UP=y
CONFIG_ARM_CPU_TOPOLOGY=y
CONFIG_VMSPLIT_2G=y
CONFIG_ARM_PSCI=y
CONFIG_PREEMPT=y
CONFIG_ARM_PATCH_IDIV=y
CONFIG_HIGHMEM=y
CONFIG_HIGHPTE=y
CONFIG_CPU_SW_DOMAIN_PAN=y
CONFIG_MEMORY_ISOLATION=y
CONFIG_COMPACTION=y
CONFIG_CMA=y
CONFIG_SECCOMP=y

#
# CPU Frequency scaling
#
CONFIG_CPU_FREQ=y
CONFIG_CPU_FREQ_GOV_ATTR_SET=y
CONFIG_CPU_FREQ_GOV_COMMON=y
CONFIG_CPU_FREQ_STAT=y
CONFIG_CPU_FREQ_DEFAULT_GOV_ONDEMAND=y
CONFIG_CPU_FREQ_GOV_POWERSAVE=y
CONFIG_CPU_FREQ_GOV_USERSPACE=y
CONFIG_CPU_FREQ_GOV_CONSERVATIVE=y
CONFIG_CPU_FREQ_GOV_INTERACTIVE=y

#
# CPU frequency scaling drivers
#
CONFIG_CPUFREQ_DT=y
CONFIG_ARM_IMX6Q_CPUFREQ=y

#
# CPU Idle
#
CONFIG_CPU_IDLE=y

#
# Floating point emulation
#
CONFIG_VFP=y
CONFIG_VFPv3=y
CONFIG_NEON=y

#
# Userspace binary formats
#
CONFIG_BINFMT_ELF=y
CONFIG_ELFCORE=y
CONFIG_CORE_DUMP_DEFAULT_ELF_HEADERS=y
CONFIG_BINFMT_SCRIPT=y
CONFIG_BINFMT_MISC=y
CONFIG_COREDUMP=y

#
# Networking options
#
CONFIG_NET=y
CONFIG_PACKET=y
CONFIG_UNIX=y
CONFIG_INET=y

#
# Network testing
#
CONFIG_WIRELESS=y
CONFIG_CFG80211=m
CONFIG_MAC80211=m

#
# Some wireless drivers require a rate control algorithm
#
CONFIG_RFKILL=y
CONFIG_WEXT_CORE=y
CONFIG_WEXT_PROC=y
CONFIG_NL80211_TESTMODE=y
CONFIG_CFG80211_WEXT=y

#
# Generic Driver Options
#
CONFIG_UEVENT_HELPER=y
CONFIG_UEVENT_HELPER_PATH=""
CONFIG_DEVTMPFS=y
CONFIG_DEVTMPFS_MOUNT=y
CONFIG_STANDALONE=y
CONFIG_PREVENT_FIRMWARE_BUILD=y
CONFIG_FW_LOADER=y
CONFIG_FIRMWARE_IN_KERNEL=y
CONFIG_FW_LOADER_USER_HELPER=y
CONFIG_FW_LOADER_USER_HELPER_FALLBACK=y
CONFIG_ALLOW_DEV_COREDUMP=y
CONFIG_DMA_CMA=y

#
# Default contiguous memory area size:
#
CONFIG_CMA_SIZE_MBYTES=320

#
# Network Adapter support
#
CONFIG_NETDEVICES=y
CONFIG_NET_CORE=y
CONFIG_WLAN=y
CONFIG_WLAN_VENDOR_TI=y
CONFIG_WL18XX=m
CONFIG_WLCORE=m
CONFIG_WLCORE_SDIO=m

#
# Input device support
#
CONFIG_INPUT_EVDEV=y
CONFIG_INPUT_KEYBOARD=y
CONFIG_KEYBOARD_GPIO=y

#
# Character devices
#
CONFIG_TTY=y
CONFIG_VT=y
CONFIG_CONSOLE_TRANSLATIONS=y
CONFIG_VT_CONSOLE=y
CONFIG_UNIX98_PTYS=y
CONFIG_LEGACY_PTYS=y
CONFIG_LEGACY_PTY_COUNT=1
CONFIG_DEVMEM=y

#
# Serial drivers
#
CONFIG_SERIAL_IMX=y
CONFIG_SERIAL_IMX_CONSOLE=y
CONFIG_SERIAL_CORE=y
CONFIG_SERIAL_CORE_CONSOLE=y
CONFIG_SERIAL_FSL_LPUART=y
CONFIG_SERIAL_FSL_LPUART_CONSOLE=y
CONFIG_SERIAL_MCTRL_GPIO=y
CONFIG_FSL_OTP=y
CONFIG_HW_RANDOM=y
CONFIG_HW_RANDOM_IMX_RNGC=y

#
# I2C support
#
CONFIG_I2C=y
CONFIG_I2C_CHARDEV=y
CONFIG_I2C_IMX=y
CONFIG_SPI=y
CONFIG_SPI_IMX=y
CONFIG_SPI_SPIDEV=y

#
# Pin controllers
#
CONFIG_PINCTRL=y

#
# Memory mapped GPIO drivers
#
CONFIG_GPIO_MXC=y

#
# Native drivers
#
CONFIG_WATCHDOG=y
CONFIG_WATCHDOG_CORE=y
CONFIG_WATCHDOG_HANDLE_BOOT_ENABLED=y
CONFIG_THERMAL=y
CONFIG_THERMAL_OF=y
CONFIG_CPU_THERMAL=y
CONFIG_IMX_THERMAL=y

#
# Watchdog Device Drivers
#
CONFIG_IMX2_WDT=y

#
# Multifunction device drivers
#
CONFIG_MFD_SYSCON=y
CONFIG_REGULATOR=y
CONFIG_REGULATOR_FIXED_VOLTAGE=y
CONFIG_REGULATOR_VIRTUAL_CONSUMER=y
CONFIG_REGULATOR_USERSPACE_CONSUMER=y
CONFIG_REGULATOR_ANATOP=y

#
# Console display driver support
#
CONFIG_DUMMY_CONSOLE=y

#
# MMC/SD/SDIO Host Controller Drivers
#
CONFIG_MMC=y
CONFIG_MMC_MQ_DEFAULT=y
CONFIG_PWRSEQ_EMMC=y
CONFIG_PWRSEQ_SIMPLE=y
CONFIG_MMC_BLOCK=y
CONFIG_MMC_BLOCK_MINORS=8
CONFIG_MMC_SDHCI=y
CONFIG_MMC_SDHCI_IO_ACCESSORS=y
CONFIG_MMC_SDHCI_PLTFM=y
CONFIG_MMC_SDHCI_ESDHC_IMX=y
CONFIG_MMC_CQHCI=y

#
# LED drivers
#
CONFIG_NEW_LEDS=y
CONFIG_LEDS_CLASS=y
CONFIG_LEDS_TRIGGERS=y

#
# RTC interfaces
#
CONFIG_RTC_CLASS=y
CONFIG_RTC_INTF_SYSFS=y
CONFIG_RTC_INTF_PROC=y
CONFIG_RTC_INTF_DEV=y
CONFIG_RTC_INTF_DEV_UIE_EMUL=y

#
# on-CPU RTC drivers
#
CONFIG_RTC_DRV_MXC=y
CONFIG_RTC_DRV_SNVS=y

#
# HID Sensor RTC drivers
#
CONFIG_DMADEVICES=y

#
# DMA Devices
#
CONFIG_DMA_VIRTUAL_CHANNELS=y
CONFIG_IMX_SDMA=y

#
# Clock Source drivers
#
CONFIG_IOMMU_SUPPORT=y

#
# i.MX SoC drivers
#
CONFIG_PWM=y
CONFIG_PWM_IMX=y
CONFIG_RESET_CONTROLLER=y
CONFIG_RESET_GPIO=y

#
# Performance monitor support
#
CONFIG_ARM_PMU=y

#
# File systems
#
CONFIG_EXT4_FS=y
CONFIG_FILE_LOCKING=y
CONFIG_MANDATORY_FILE_LOCKING=y
CONFIG_FSNOTIFY=y
CONFIG_DNOTIFY=y
CONFIG_INOTIFY_USER=y
CONFIG_AUTOFS4_FS=y

#
# DOS/FAT/NT Filesystems
#
CONFIG_MSDOS_FS=y

#
# Pseudo filesystems
#
CONFIG_PROC_FS=y
CONFIG_PROC_SYSCTL=y
CONFIG_PROC_PAGE_MONITOR=y
CONFIG_KERNFS=y
CONFIG_SYSFS=y
CONFIG_TMPFS=y
CONFIG_TMPFS_XATTR=y
CONFIG_MISC_FILESYSTEMS=y
CONFIG_PSTORE=y
CONFIG_PSTORE_CONSOLE=y
CONFIG_PSTORE_RAM=y

#
# printk and dmesg options
#
CONFIG_PRINTK_TIME=y

#
# Crypto core or helper
#
CONFIG_CRYPTO_AEAD=y
CONFIG_CRYPTO_BLKCIPHER=y
CONFIG_CRYPTO_RNG=y
CONFIG_CRYPTO_RSA=y
CONFIG_CRYPTO_MANAGER=y
CONFIG_CRYPTO_MANAGER_DISABLE_TESTS=y
CONFIG_CRYPTO_NULL=y
CONFIG_CRYPTO_AUTHENC=y

#
# Authenticated Encryption with Associated Data
#
CONFIG_CRYPTO_ECHAINIV=m

#
# Ciphers
#
CONFIG_CRYPTO_DES=y

#
# Random Number Generation
#
CONFIG_CRYPTO_HW=y
CONFIG_CRYPTO_DEV_FSL_CAAM=y
CONFIG_CRYPTO_DEV_FSL_CAAM_JR=y
CONFIG_CRYPTO_DEV_FSL_CAAM_CRYPTO_API=y
CONFIG_CRYPTO_DEV_FSL_CAAM_AHASH_API=y
CONFIG_CRYPTO_DEV_FSL_CAAM_CRYPTO_API_DESC=y
CONFIG_CRYPTO_DEV_FSL_CAAM_AHASH_API_DESC=y
CONFIG_CRYPTO_DEV_FSL_CAAM_PKC_API=y
CONFIG_CRYPTO_DEV_FSL_CAAM_RNG_API=y

#
# Library routines
#
CONFIG_CRC7=y
CONFIG_NEW_LEDS=y
```

## meta-glowforge-bsp/wic/glowforge.wks
```
# short-description: Create SD card image with a boot partition
# long-description:
# Create an image that can be written onto a SD card using dd for use
# with i.MX SoC family
#
# The disk layout used is:
#  - -------------- --------------
# | |     boot     |    rootfs   |
#  - -------------- --------------
# ^ ^              ^
# | |              |
# 0 1KiB          4MiB + rootfs + IMAGE_EXTRA_SPACE (default 10MiB)
#
part /boot --source bootimg-partition --ondisk mmcblk --fstype=ext4 --label boot --active --align 1 --size 16
part / --source rootfs --ondisk mmcblk --fstype=ext4 --label root --align 4096

bootloader --ptable msdos
```

## meta-openglow-bsp/conf/distro/openglow.conf
```bitbake
require conf/distro/include/fslc-base.inc

DISTRO = "openglow"
DISTRO_NAME = "OpenGlow"
DISTRO_VERSION = "development"

DISTRO_FEATURES_remove = " 3g alsa avahi irda nfc nfs pcmcia pulseaudio wayland x11 zeroconf "
```

## meta-openglow-bsp/conf/layer.conf
```bitbake
# We have a conf and classes directory, add to BBPATH
BBPATH .= ":${LAYERDIR}"

# We have recipes-* directories, add to BBFILES
BBFILES += "${LAYERDIR}/recipes-*/*/*.bb \
	${LAYERDIR}/recipes-*/*/*.bbappend"

BBFILE_COLLECTIONS += "openglow-bsp-layer"
BBFILE_PATTERN_openglow-bsp-layer = "^${LAYERDIR}/"
BBFILE_PRIORITY_openglow-bsp-layer = "9"

# This should only be incremented on significant changes that will
# cause compatibility issues with other layers
LAYERVERSION_openglow-bsp-layer = "1"

LAYERSERIES_COMPAT_openglow-bsp-layer = "dunfell gatesgarth"
```

## meta-openglow-bsp/recipes-bsp/u-boot/files/git/board/openglow/openglow_std/Kconfig
```kconfig
if TARGET_OPENGLOW_STD

config SYS_BOARD
	default "openglow_std"

config SYS_VENDOR
	default "openglow"

config SYS_CONFIG_NAME
	default "openglow_std"

endif
```

## meta-openglow-core/conf/layer.conf
```bitbake
# We have a conf and classes directory, add to BBPATH
BBPATH .= ":${LAYERDIR}"

# We have recipes-* directories, add to BBFILES
BBFILES += "${LAYERDIR}/recipes-*/*/*.bb \
	${LAYERDIR}/recipes-*/*/*.bbappend"

BBFILE_COLLECTIONS += "openglow-core-layer"
BBFILE_PATTERN_openglow-core-layer = "^${LAYERDIR}/"
BBFILE_PRIORITY_openglow-core-layer = "8"

# This should only be incremented on significant changes that will
# cause compatibility issues with other layers
LAYERVERSION_openglow-core-layer = "1"

LAYERSERIES_COMPAT_openglow-core-layer = "dunfell gatesgarth"
```

## recipes-bsp/u-boot/files/git/configs/openglow_std_n6x2q_1g_defconfig
```kconfig
CONFIG_SYS_EXTRA_OPTIONS="IMX_CONFIG=board/openglow/openglow_std/openglow_std_n6x2q_1g.cfg,MX6Q,DDR_MB=1024"
CONFIG_TARGET_OPENGLOW_STD=y
CONFIG_ARM=y
CONFIG_ARCH_MX6=y
CONFIG_MX6Q=y
CONFIG_BOOTDELAY=3
CONFIG_SYS_CONSOLE_OVERWRITE_ROUTINE=y
# CONFIG_SYS_STDIO_DEREGISTER is not set
CONFIG_BOARD_EARLY_INIT_F=y
CONFIG_HUSH_PARSER=y
CONFIG_FASTBOOT=y
CONFIG_FASTBOOT_BUF_ADDR=0x12000000
CONFIG_CMD_BOOTZ=y
CONFIG_CMD_MEMTEST=y
# CONFIG_CMD_FLASH is not set
CONFIG_CMD_GPIO=y
CONFIG_CMD_MMC=y
CONFIG_CMD_CACHE=y
CONFIG_CMD_TIME=y
CONFIG_CMD_EXT2=y
CONFIG_CMD_EXT4=y
CONFIG_CMD_EXT4_WRITE=y
CONFIG_CMD_FAT=y
CONFIG_CMD_FS_GENERIC=y
CONFIG_ENV_IS_IN_SPI_FLASH=y
CONFIG_SPI_FLASH=y
CONFIG_SPI_FLASH_SST=y
CONFIG_SPI_FLASH_GIGADEVICE=y
CONFIG_SPI_FLASH_SPANSION=y
CONFIG_OF_LIBFDT=y
CONFIG_SYS_FSL_USDHC_NUM=2
```
